/*
 * Copyright (c) 2020-2021, SHIFT GmbH. All rights reserved.
 *
 * This program is free software; you can redistribute it and/or modify
 * it under the terms of the GNU General Public License version 2 and
 * only version 2 as published by the Free Software Foundation.
 *
 * This program is distributed in the hope that it will be useful,
 * but WITHOUT ANY WARRANTY; without even the implied warranty of
 * MERCHANTABILITY or FITNESS FOR A PARTICULAR PURPOSE.  See the
 * GNU General Public License for more details.
 */

qcom,SHIFT_3820mAh {
	qcom, = <24>;
	/* #4261808_*_Oct24th2019*/
	qcom,max-voltage-uv = <4400000>;
	qcom,fg-cc-cv-threshold-mv = <4390>;
	qcom,nom-batt-capacity-mah = <3820>;
	qcom,fastchg-current-ma = <3000>;
	qcom,batt-id-kohm = <100>;
	qcom,battery-beta = <3380>;
	qcom,battery-type = "SHIFT_3820mAh";
	qcom,checksum = <0x414B>;
	qcom,gui-version = "PMI8998GUI - 2.0.0.58";
	qcom,fg-profile-data = [
		 BA 1E F9 FC
		 9B 03 21 F4
		 A8 1C 82 02
		 9B 0C 00 12
		 98 17 5B 23
		 49 45 08 53
		 63 00 00 00
		 13 00 00 00
		 00 00 57 C4
		 B9 C5 5F CA
		 1E 00 08 00
		 0A 00 54 E5
		 E5 06 82 F2
		 8A F3 92 12
		 9D FA A3 4B
		 12 06 09 20
		 27 00 14 00
		 5F 1F F4 05
		 2C 0A AD 06
		 A3 1C 56 03
		 8E 15 C3 12
		 62 18 FE 23
		 BE 4D 8C 5B
		 61 00 00 00
		 0D 00 00 00
		 00 00 35 D5
		 37 CB 24 CA
		 19 00 00 00
		 5E EA 54 E5
		 3C 07 DC EA
		 2C DC B3 03
		 A9 01 C5 1A
		 B0 33 CC FF
		 07 10 00 00
		 8E 0F 66 46
		 19 00 40 00
		 7B 01 0A FA
		 FF 00 00 00
		 00 00 00 00
		 00 00 00 00
		 00 00 00 00
		 00 00 00 00
		 00 00 00 00
		 00 00 00 00
		 00 00 00 00
		 00 00 00 00
		 00 00 00 00
		 00 00 00 00
		 00 00 00 00
		 00 00 00 00
		 00 00 00 00
		 00 00 00 00
		 00 00 00 00
		 00 00 00 00
		 00 00 00 00
		 00 00 00 00
	];
};
