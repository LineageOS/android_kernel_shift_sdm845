## Kconfig
```kconfig
#
# For a description of the syntax of this configuration file,
# see Documentation/kbuild/kconfig-language.txt.
#
mainmenu "Linux/$ARCH $KERNELVERSION Kernel Configuration"

config SRCARCH
	string
	option env="SRCARCH"

menu "SHIFT Project Configuration"

config SHIFT_PROJECT
	bool "Enable SHIFT Project"
	default n
	help
	  This enables support for SHIFT projects. If you don't
	  know what to do here, you are probably as confused
	  as i am.

endmenu

source "arch/$SRCARCH/Kconfig"
```
